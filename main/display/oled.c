#include <string.h>
#include <stdint.h>
#include "freertos/FreeRTOS.h"
#include "freertos/task.h"
#include "driver/i2c.h"
#include "driver/gpio.h"
#include "esp_log.h"
#include "oled.h"
#include "../config.h"

static const char *TAG = "oled";

#define I2C_PORT        I2C_NUM_0
#define I2C_TIMEOUT_MS  100

/* ── SSD1306 commands ────────────────────────────────────────────────────── */
#define OLED_CMD_DISPLAY_OFF    0xAE
#define OLED_CMD_DISPLAY_ON     0xAF
#define OLED_CMD_SET_CLK        0xD5
#define OLED_CMD_SET_MUX        0xA8
#define OLED_CMD_SET_OFFSET     0xD3
#define OLED_CMD_SET_START_LINE 0x40
#define OLED_CMD_CHARGE_PUMP    0x8D
#define OLED_CMD_MEM_MODE       0x20
#define OLED_CMD_SEG_REMAP      0xA1
#define OLED_CMD_COM_SCAN_DEC   0xC8
#define OLED_CMD_SET_COM_PINS   0xDA
#define OLED_CMD_SET_CONTRAST   0x81
#define OLED_CMD_SET_PRECHARGE  0xD9
#define OLED_CMD_SET_VCOMH      0xDB
#define OLED_CMD_DISPLAY_RAM    0xA4
#define OLED_CMD_NORMAL_DISPLAY 0xA6
#define OLED_CMD_COL_ADDR       0x21
#define OLED_CMD_PAGE_ADDR      0x22

/* Frame buffer: 128 × 8 pages × 1 byte-per-column = 1024 bytes */
static uint8_t s_fb[OLED_HEIGHT / 8][OLED_WIDTH];

/* ── 5×7 ASCII font (cols), characters 0x20–0x7E ────────────────────────── */
static const uint8_t FONT5x7[][5] = {
    {0x00,0x00,0x00,0x00,0x00}, /* ' ' */  {0x00,0x00,0x5F,0x00,0x00}, /* ! */
    {0x00,0x07,0x00,0x07,0x00}, /* " */    {0x14,0x7F,0x14,0x7F,0x14}, /* # */
    {0x24,0x2A,0x7F,0x2A,0x12}, /* $ */    {0x23,0x13,0x08,0x64,0x62}, /* % */
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    {0x08,0x08,0x2A,0x1C,0x08}, /* ~ */
};

/* ── I2C helpers ─────────────────────────────────────────────────────────── */

static esp_err_t i2c_write_cmd(uint8_t cmd) {
    uint8_t buf[2] = {0x00, cmd};
    i2c_cmd_handle_t h = i2c_cmd_link_create();
    i2c_master_start(h);
    i2c_master_write_byte(h, (OLED_ADDR << 1) | I2C_MASTER_WRITE, true);
    i2c_master_write(h, buf, 2, true);
    i2c_master_stop(h);
    esp_err_t ret = i2c_master_cmd_begin(I2C_PORT, h, pdMS_TO_TICKS(I2C_TIMEOUT_MS));
    i2c_cmd_link_delete(h);
    return ret;
}

static esp_err_t i2c_write_data(const uint8_t *data, size_t len) {
    i2c_cmd_handle_t h = i2c_cmd_link_create();
    i2c_master_start(h);
    i2c_master_write_byte(h, (OLED_ADDR << 1) | I2C_MASTER_WRITE, true);
    i2c_master_write_byte(h, 0x40, true);  /* data mode */
    i2c_master_write(h, (uint8_t *)data, len, true);
    i2c_master_stop(h);
    esp_err_t ret = i2c_master_cmd_begin(I2C_PORT, h, pdMS_TO_TICKS(I2C_TIMEOUT_MS));
    i2c_cmd_link_delete(h);
    return ret;
}

/* ── Public API ──────────────────────────────────────────────────────────── */

esp_err_t oled_init(void) {
    /* Hardware reset via GPIO16 — required for V1.0 before I2C init */
    gpio_config_t rst_cfg = {
        .pin_bit_mask = 1ULL << OLED_RST,
        .mode         = GPIO_MODE_OUTPUT,
    };
    gpio_config(&rst_cfg);
    gpio_set_level(OLED_RST, 0);
    vTaskDelay(pdMS_TO_TICKS(20));
    gpio_set_level(OLED_RST, 1);
    vTaskDelay(pdMS_TO_TICKS(5));

    /* I2C bus init */
    i2c_config_t conf = {
        .mode             = I2C_MODE_MASTER,
        .sda_io_num       = OLED_SDA,
        .scl_io_num       = OLED_SCL,
        .sda_pullup_en    = GPIO_PULLUP_ENABLE,
        .scl_pullup_en    = GPIO_PULLUP_ENABLE,
        .master.clk_speed = 400000,
    };
    ESP_ERROR_CHECK(i2c_param_config(I2C_PORT, &conf));
    ESP_ERROR_CHECK(i2c_driver_install(I2C_PORT, I2C_MODE_MASTER, 0, 0, 0));

    /* SSD1306 init sequence */
    static const uint8_t INIT_SEQ[] = {
        OLED_CMD_DISPLAY_OFF,
        OLED_CMD_SET_CLK,        0x80,
        OLED_CMD_SET_MUX,        0x3F,   /* 64 MUX */
        OLED_CMD_SET_OFFSET,     0x00,
        OLED_CMD_SET_START_LINE,
        OLED_CMD_CHARGE_PUMP,    0x14,   /* internal charge pump on */
        OLED_CMD_MEM_MODE,       0x00,   /* horizontal addressing */
        OLED_CMD_SEG_REMAP,
        OLED_CMD_COM_SCAN_DEC,
        OLED_CMD_SET_COM_PINS,   0x12,
        OLED_CMD_SET_CONTRAST,   0xCF,
        OLED_CMD_SET_PRECHARGE,  0xF1,
        OLED_CMD_SET_VCOMH,      0x40,
        OLED_CMD_DISPLAY_RAM,
        OLED_CMD_NORMAL_DISPLAY,
        OLED_CMD_DISPLAY_ON,
    };
    for (size_t i = 0; i < sizeof(INIT_SEQ); i++) {
        esp_err_t ret = i2c_write_cmd(INIT_SEQ[i]);
        if (ret != ESP_OK) {
            ESP_LOGE(TAG, "OLED init cmd 0x%02X failed: %s", INIT_SEQ[i], esp_err_to_name(ret));
            return ret;
        }
    }

    oled_clear();
    oled_flush();
    ESP_LOGI(TAG, "SSD1306 OLED initialised (128x64 @ I2C 0x%02X)", OLED_ADDR);
    return ESP_OK;
}

void oled_clear(void) {
    memset(s_fb, 0, sizeof(s_fb));
}

void oled_puts(uint8_t col, uint8_t row, const char *str) {
    /* row = page index (0–7), col = pixel column (0–127) */
    while (*str && col < OLED_WIDTH) {
        uint8_t c = (uint8_t)*str++;
        if (c < 0x20 || c > 0x7E) c = ' ';
        const uint8_t *glyph = FONT5x7[c - 0x20];
        for (int x = 0; x < 5 && col < OLED_WIDTH; x++, col++)
            s_fb[row][col] = glyph[x];
        if (col < OLED_WIDTH) s_fb[row][col++] = 0x00;  /* 1-px spacer */
    }
}

static esp_err_t i2c_write_cmd_seq(const uint8_t *cmds, size_t len) {
    /* Send multiple command bytes in a single I2C transaction.
     * Required for multi-byte SSD1306 commands (e.g. 0x21 col-addr needs
     * start+end bytes to follow in the same transfer). */
    i2c_cmd_handle_t h = i2c_cmd_link_create();
    i2c_master_start(h);
    i2c_master_write_byte(h, (OLED_ADDR << 1) | I2C_MASTER_WRITE, true);
    i2c_master_write_byte(h, 0x00, true);  /* control: all bytes are commands */
    i2c_master_write(h, (uint8_t *)cmds, len, true);
    i2c_master_stop(h);
    esp_err_t ret = i2c_master_cmd_begin(I2C_PORT, h, pdMS_TO_TICKS(I2C_TIMEOUT_MS));
    i2c_cmd_link_delete(h);
    return ret;
}

void oled_flush(void) {
    /* Set column 0–127 and page 0–7 (full screen) then stream frame buffer */
    static const uint8_t addr_cmds[] = {
        OLED_CMD_COL_ADDR,  0, 127,
        OLED_CMD_PAGE_ADDR, 0, 7,
    };
    i2c_write_cmd_seq(addr_cmds, sizeof(addr_cmds));
    for (int page = 0; page < OLED_HEIGHT / 8; page++)
        i2c_write_data(s_fb[page], OLED_WIDTH);
}
